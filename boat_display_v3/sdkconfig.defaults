## boat_display_v3/sdkconfig.defaults
```kconfig
# ─── Flash & PSRAM ───────────────────────────────────────────
CONFIG_ESPTOOLPY_FLASHSIZE_8MB=y
CONFIG_SPIRAM=y
CONFIG_SPIRAM_MODE_OCT=y
CONFIG_SPIRAM_SPEED_80M=y
CONFIG_SPIRAM_BOOT_INIT=y
CONFIG_SPIRAM_USE_MALLOC=y

# ─── BSP options ─────────────────────────────────────────────
CONFIG_BSP_I2C_NUM=1
CONFIG_BSP_I2C_CLK_SPEED_HZ=400000
CONFIG_BSP_I2S_NUM=0

CONFIG_BSP_SPIFFS_MOUNT_POINT="/spiffs"
CONFIG_BSP_SPIFFS_PARTITION_LABEL="storage"
CONFIG_BSP_SPIFFS_MAX_FILES=5

# LVGL display buffer height (lines). 50 is a good balance.
CONFIG_BSP_DISPLAY_LVGL_BUF_HEIGHT=50

# Number of RGB frame buffers in PSRAM (1 = less RAM, 2 = tear-free)
CONFIG_BSP_LCD_RGB_BUFFER_NUMS=2

# Bounce buffer mode — required when PSRAM frame buffer is used
CONFIG_BSP_LCD_RGB_BOUNCE_BUFFER_MODE=y
CONFIG_BSP_LCD_RGB_BOUNCE_BUFFER_HEIGHT=20

# Use PSRAM for LVGL buffer
CONFIG_BSP_DISPLAY_LVGL_PSRAM=y

# Avoid tearing with double-buffer
CONFIG_BSP_DISPLAY_LVGL_AVOID_TEAR=y

# ─── FreeRTOS ────────────────────────────────────────────────
CONFIG_FREERTOS_HZ=1000
CONFIG_FREERTOS_UNICORE=n

# ─── Networking ──────────────────────────────────────────────
CONFIG_ESP_WIFI_STATIC_RX_BUFFER_NUM=10
CONFIG_ESP_WIFI_DYNAMIC_RX_BUFFER_NUM=32
CONFIG_ESP_WIFI_TX_BUFFER_TYPE_DYNAMIC=y

# WebSocket client
CONFIG_WS_TRANSPORT_MAX_CONTROL_FRAME_BUFFER_LEN=128
CONFIG_WEBSOCKET_CLIENT_BUFFER_SIZE=4096

# ─── Logging ─────────────────────────────────────────────────
CONFIG_LOG_DEFAULT_LEVEL_INFO=y
CONFIG_ESP_CONSOLE_USB_SERIAL_JTAG=y
CONFIG_ESP_CONSOLE_UART_DEFAULT=n

CONFIG_LV_FONT_MONTSERRAT_12=y
CONFIG_LV_FONT_MONTSERRAT_14=y
CONFIG_LV_FONT_MONTSERRAT_16=y
CONFIG_LV_FONT_MONTSERRAT_24=y
CONFIG_LV_FONT_MONTSERRAT_32=y
CONFIG_LV_FONT_MONTSERRAT_48=y
CONFIG_LV_FONT_DEFAULT_CODEPOINT_MIN=0x20
CONFIG_LV_FONT_DEFAULT_CODEPOINT_MAX=0xFF

CONFIG_SPIRAM_FETCH_INSTRUCTIONS=y 
CONFIG_SPIRAM_RODATA=y
CONFIG_ESP32S3_DATA_CACHE_SIZE_64KB=y
CONFIG_ESP32S3_DATA_CACHE_LINE_64B=y

CONFIG_ESP_TASK_WDT_TIMEOUT_S=15
CONFIG_BSP_DISPLAY_LVGL_TASK_CORE_ID=1

# ─── LVGL Memory ─────────────────────────────────────────────
# 96KB needed — 64KB causes fragmentation with current widget count
# If adding more pages/widgets, increase this value
CONFIG_LV_MEM_SIZE_KILOBYTES=96
```
